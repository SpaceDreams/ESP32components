## SDcard/SDmmc/Kconfig.mmc
```kconfig
menu "SD Using MMC Configuration"
    choice LIB_SDMMC_BUS_WIDTH
        prompt "SD/MMC bus width"
        default LIB_SDMMC_BUS_WIDTH_4
        help
            Select the bus width of SD or MMC interface.
            Note that even if 1 line mode is used, D3 pin of the SD card must have a pull-up resistor connected.
            Otherwise the card may enter SPI mode, the only way to recover from which is to cycle power to the card.

        config LIB_SDMMC_BUS_WIDTH_4
            bool "4 lines (D0 - D3)"

        config LIB_SDMMC_BUS_WIDTH_1
            bool "1 line (D0)"
    endchoice

    choice LIB_SDMMC_SPEED_MODE
        prompt "SD/MMC speed mode"
        default LIB_SDMMC_SPEED_DS

        config LIB_SDMMC_SPEED_DS
            bool "Default Speed"
        config LIB_SDMMC_SPEED_HS
            bool "High Speed"
        config LIB_SDMMC_SPEED_UHS_I_SDR50
            bool "UHS-I SDR50 (100 MHz, 50 MB/s)"
            depends on SOC_SDMMC_UHS_I_SUPPORTED
        config LIB_SDMMC_SPEED_UHS_I_DDR50
            bool "UHS-I DDR50 (50 MHz, 50 MB/s)"
            depends on SOC_SDMMC_UHS_I_SUPPORTED
        config LIB_SDMMC_SPEED_UHS_I_SDR104
            bool "UHS-I SDR104 (200 MHz, 100 MB/s)"
            depends on SOC_SDMMC_UHS_I_SUPPORTED
    endchoice
    config LIB_PIN_CMD
        int
        prompt "CMD GPIO number" if SOC_SDMMC_USE_GPIO_MATRIX
        default 48
        help
            The default is set for the CRB board

    config LIB_PIN_CLK
        int
        prompt "CLK GPIO number" if SOC_SDMMC_USE_GPIO_MATRIX
        default 47
        help
            The default is set for the CRB board

    config LIB_PIN_D0
        int
        prompt "D0 GPIO number" if SOC_SDMMC_USE_GPIO_MATRIX
        default 39
        help
            The default is set for the CRB board

    if LIB_SDMMC_BUS_WIDTH_4

        config LIB_PIN_D1
            int
            prompt "D1 GPIO number" if SOC_SDMMC_USE_GPIO_MATRIX
            default 40
            help
                The default is set for the CRB board


        config LIB_PIN_D2
            int
            prompt "D2 GPIO number" if SOC_SDMMC_USE_GPIO_MATRIX
            default 0
            help
                The default is set for the CRB board


        config LIB_PIN_D3
            int
            prompt "D3 GPIO number" if SOC_SDMMC_USE_GPIO_MATRIX
            default 38
            help
                The default is set for the CRB board
    endif  # LIB_SDMMC_BUS_WIDTH_4
endmenu
```

## examples/FaucetDetectionModel/main/Kconfig.projbuild
```kconfig
menu "Model Configuration"

    config MODEL_FILENAME
        string "ESPDL Model Filename exculding the .espdl"
        default "signaldect_2D_ESP32"
        help
            The name of the .espdl model file located in the target directory.

endmenu
```

## examples/I2Srecording/main/Kconfig.projbuild
```kconfig
menu "I2S Configuration"
    menu "I2S GPIOs config"
        config I2S_MCK_IO
            int "MCK pin"
            default -1
            help 
                unused pin is set to -1

        config I2S_BCK_IO
            int "BCK pin"
            default 41

        config I2S_WS_IO
            int "WS pin"
            default 42

        config I2S_DO_IO
            int "DOUT pin"
            default -1
            help 
                unused pin is set to -1

        config I2S_DI_IO
            int "DIN pin"
            default 2

    endmenu
endmenu
```
