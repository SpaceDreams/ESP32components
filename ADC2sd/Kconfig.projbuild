## ADC2sd/Kconfig.projbuild
```kconfig
menu "ADC Configuration"
    config INIT_SAMPLE_RATE
        int "Sample Rate"
        default 44100
        help
            Set the sample rate frequency.
            Oversample rate usually can be 2048000 or 5644800 Hz if only raw PDM data format supported.
endmenu
```

## I2S2sd/Kconfig.projbuild
```kconfig
menu "I2S Configuration"

    choice AUDIO_SAMPLE
        int "Audio Sample Rate"
        default AUDIO_SAMPLE_48K
        help
            Set the audio sample rate frequency. Max is 48kHz

        config AUDIO_SAMPLE_8K
            bool "8KHz"
        config AUDIO_SAMPLE_16K
            bool "16KHz"
        config AUDIO_SAMPLE_24K
            bool "24KHz"
        config AUDIO_SAMPLE_48K
            bool "48KHz"
    endchoice

    config AUDIO_SAMPLE_RATE
        int
        default 8000 if AUDIO_SAMPLE_8K
        default 16000 if AUDIO_SAMPLE_16K
        default 24000 if AUDIO_SAMPLE_24K
        default 48000 if AUDIO_SAMPLE_48K

    choice BIT_WIDTH
        prompt "Audio data bit width"
        default BIT_WIDTH_24BIT
        help
            Define the number of bits for each sample. Default 24 bits per sample.

        config BIT_WIDTH_8BIT
            bool "8-bit"
        config BIT_WIDTH_16BIT
            bool "16-bit"
        config BIT_WIDTH_24BIT
            bool "24-bit"
        config BIT_WIDTH_32BIT
            bool "32-bit"
    endchoice

    config AUDIO_BIT_WIDTH
        int
        default 8 if BIT_WIDTH_8BIT
        default 16 if BIT_WIDTH_16BIT
        default 24 if BIT_WIDTH_24BIT
        default 32 if BIT_WIDTH_32BIT
    menu "I2S GPIOs config"
        config I2S_MCK_IO
            int "MCK pin"
            default -1
            help 
                unused pin is set to -1

        config I2S_BCK_IO
            int "BCK pin"
            default 41

        config I2S_WS_IO
            int "WS pin"
            default 42

        config I2S_DO_IO
            int "DOUT pin"
            default -1
            help 
                unused pin is set to -1

        config I2S_DI_IO
            int "DIN pin"
            default 2

    endmenu
endmenu
```

## initI2S/Kconfig.projbuild
```kconfig
menu "I2S Configuration"
    config AUDIO_SAMPLE_RATE
        int "Audio Sample Rate"
        default 48000
        help
            Set the audio sample rate frequency. Max is 48kHz

    choice BIT_WIDTH
        prompt "Audio data bit width"
        default BIT_WIDTH_24BIT
        help
            Define the number of bits for each sample. Default 24 bits per sample.

        config BIT_WIDTH_8BIT
            bool "8-bit"
        config BIT_WIDTH_16BIT
            bool "16-bit"
        config BIT_WIDTH_24BIT
            bool "24-bit"
        config BIT_WIDTH_32BIT
            bool "32-bit"
    endchoice

    config AUDIO_BIT_WIDTH
        int
        default 8 if BIT_WIDTH_8BIT
        default 16 if BIT_WIDTH_16BIT
        default 24 if BIT_WIDTH_24BIT
        default 32 if BIT_WIDTH_32BIT
    menu "I2S GPIOs config"
        config I2S_MCK_IO
            int "MCK pin"
            default -1
            help 
                unused pin is set to -1

        config I2S_BCK_IO
            int "BCK pin"
            default 41

        config I2S_WS_IO
            int "WS pin"
            default 42

        config I2S_DO_IO
            int "DOUT pin"
            default -1
            help 
                unused pin is set to -1

        config I2S_DI_IO
            int "DIN pin"
            default 2

    endmenu
endmenu
```

## initSDmmc/Kconfig.projbuild
```kconfig
menu "SD Using MMC Configuration"

    menu "SDCard Configuration"

        config SD_MOUNT_POINT
            string "/sdcard"
            default "/sdcard"
            help
                This is the directory on the ESP32 where the sd card is mounted.

        choice EXAMPLE_SDMMC_BUS_WIDTH
            prompt "SD/MMC bus width"
            default EXAMPLE_SDMMC_BUS_WIDTH_4
            help
                Select the bus width of SD or MMC interface.
                Note that even if 1 line mode is used, D3 pin of the SD card must have a pull-up resistor connected.
                Otherwise the card may enter SPI mode, the only way to recover from which is to cycle power to the card.
    
            config EXAMPLE_SDMMC_BUS_WIDTH_4
                bool "4 lines (D0 - D3)"
    
            config EXAMPLE_SDMMC_BUS_WIDTH_1
                bool "1 line (D0)"
        endchoice
    
        choice EXAMPLE_SDMMC_SPEED_MODE
            prompt "SD/MMC speed mode"
            default EXAMPLE_SDMMC_SPEED_DS
    
            config EXAMPLE_SDMMC_SPEED_DS
                bool "Default Speed"
            config EXAMPLE_SDMMC_SPEED_HS
                bool "High Speed"
            config EXAMPLE_SDMMC_SPEED_UHS_I_SDR50
                bool "UHS-I SDR50 (100 MHz, 50 MB/s)"
                depends on SOC_SDMMC_UHS_I_SUPPORTED
            config EXAMPLE_SDMMC_SPEED_UHS_I_DDR50
                bool "UHS-I DDR50 (50 MHz, 50 MB/s)"
                depends on SOC_SDMMC_UHS_I_SUPPORTED
            config EXAMPLE_SDMMC_SPEED_UHS_I_SDR104
                bool "UHS-I SDR104 (200 MHz, 100 MB/s)"
                depends on SOC_SDMMC_UHS_I_SUPPORTED
        endchoice

        config EXAMPLE_PIN_CMD
            int
            prompt "CMD GPIO number" if SOC_SDMMC_USE_GPIO_MATRIX
            default 48
            help
                The default is set for the CRB board
    
        config EXAMPLE_PIN_CLK
            int
            prompt "CLK GPIO number" if SOC_SDMMC_USE_GPIO_MATRIX
            default 47
            help
                The default is set for the CRB board
    
        config EXAMPLE_PIN_D0
            int
            prompt "D0 GPIO number" if SOC_SDMMC_USE_GPIO_MATRIX
            default 39
            help
                The default is set for the CRB board
    
        if EXAMPLE_SDMMC_BUS_WIDTH_4
    
            config EXAMPLE_PIN_D1
                int
                prompt "D1 GPIO number" if SOC_SDMMC_USE_GPIO_MATRIX
                default 40
                help
                    The default is set for the CRB board
    
    
            config EXAMPLE_PIN_D2
                int
                prompt "D2 GPIO number" if SOC_SDMMC_USE_GPIO_MATRIX
                default 0
                help
                    The default is set for the CRB board
    
    
            config EXAMPLE_PIN_D3
                int
                prompt "D3 GPIO number" if SOC_SDMMC_USE_GPIO_MATRIX
                default 38
                help
                    The default is set for the CRB board
    
        endif  # EXAMPLE_SDMMC_BUS_WIDTH_4
    endmenu
endmenu
```

## initSDspi/Kconfig.projbuild
```kconfig
menu "SD Using SPI Configuration"

    menu "SDCard Configuration"

        config INIT_SPI_MISO_GPIO
            int "SPI MISO GPIO"
            default 19
            help
                Set the GPIO number used for MISO from SPI.
                Default is for the SparkThings Plus C Dev Board.

        config INIT_SPI_MOSI_GPIO
            int "SPI MOSI GPIO"
            default 23
            help
                Set the GPIO number used for MOSI from SPI.
                Default is for the SparkThings Plus C Dev Board.

        config INIT_SPI_SCLK_GPIO
            int "SPI SCLK GPIO"
            default 18
            help
                Set the GPIO number used for SCLK from SPI.
                Default is for the SparkThings Plus C Dev Board.

        config INIT_SPI_CS_GPIO
            int "SPI CS GPIO"
            default 5
            help
                Set the GPIO number used for CS from SPI.
                Default is for the SparkThings Plus C Dev Board.

    endmenu

endmenu
```

## tests/I2S2sd/main/Kconfig.projbuild
```kconfig
menu "Recording Configuration"
    config REC_TIME
        int "Recording Time in Seconds"
        default 15
        help
            Set the time for recording audio in seconds.

endmenu
```
